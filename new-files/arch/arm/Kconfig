## new-files/arch/arm/Kconfig
```kconfig
# SPDX-License-Identifier: GPL-2.0
menu "Cavium Networks CNS3XXX family"

depends on ARCH_CNS3XXX

config MACH_CNS3420VB
	bool "Support for CNS3420 Validation Board"
	depends on ATAGS
	help
	  Include support for the Cavium Networks CNS3420 MPCore Platform
	  Baseboard.
	  This is a platform with an on-board ARM11 MPCore and has support
	  for USB, USB-OTG, MMC/SD/SDIO, SATA, PCI-E, etc.

config MACH_SEAGATE
	bool "Experimental Seagate Central Single Bay"
	depends on ATAGS
	help
	  This is a platform with an on-board ARM11 MPCore and has support
	  for USB, USB-OTG, MMC/SD/SDIO, SATA, PCI-E, etc.

config CNS3XXX_FAKE_SGNOTIFY_NODE
        bool "Create a fake sgnotify node for Seagate Central"
	depends on MACH_SEAGATE
	default y
	help
	  Seagate Central firmware requires that a node exist for the
	  now obsolete and defunct Seagate Media Service otherwise when
	  running the default firmware the unit may hang on boot.
	  This node serves no purpose except to stop the unit from
	  hanging on boot if the Seagate Media Service has not been
	  disabled. Recommended set to 'y' only for Seagate Central
	  Platform running Seagate supplied firmware which has the
	  Seagate Media Service software included.
	  
config CNS3XXX_HIGH_PHYS_OFFSET
        bool "High physical base address for the CNS3XXX platform"
        depends on MMU
	default y	
	help
	  CNS3XXX based systems make RAM available at physical
	  address 0x20000000, the first 256MB of which is mirrored at
	  physical address 0x00000000.
	
	  If the board has more than 256MB of RAM (unlikely), then
	  this option allows the unit to access all of that memory
	  by using the 0x20000000 high physical offset.
	
endmenu
```
